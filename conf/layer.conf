## conf/layer.conf
```bitbake
# We have a conf and classes directory, add to BBPATH
BBPATH .= ":${LAYERDIR}"

# We have recipes-* directories, add to BBFILES
BBFILES += "${LAYERDIR}/recipes-*/*/*.bb \
            ${LAYERDIR}/recipes-*/*/*.bbappend"

BBFILE_COLLECTIONS += "sources/meta-marlin"
BBFILE_PATTERN_sources/meta-marlin = "^${LAYERDIR}/"
BBFILE_PRIORITY_sources/meta-marlin = "12"

LAYERDEPENDS_meta-marlin = "core openembedded-layer"


BBMASK += "meta-fsl-bsp-release/imx/meta-sdk/dynamic-layers/qt5-layer/recipes-qt/qt5/qtwayland_%.bbappend" 
BBMASK += "meta-fsl-bsp-release/imx/meta-bsp/recipes-security/optee-imx/optee-test-imx_%.bb"
```
